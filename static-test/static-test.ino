//demo setup to simulate multiple devices for demonstration
#include <WiFi.h>
#include <PubSubClient.h>
#include <SPI.h>
#include <Adafruit_GFX.h>
#include <Adafruit_SSD1306.h>

#define SCREEN_WIDTH 128 
#define SCREEN_HEIGHT 32

#define OLED_RESET     -1 
#define SCREEN_ADDRESS 0x3C 
Adafruit_SSD1306 display(SCREEN_WIDTH, SCREEN_HEIGHT, &Wire, OLED_RESET);

// =========================
// WiFi & MQTT Config
// =========================
const char* ssid = ".........._2.4";
const char* password = "135B@Santa$$246";
const char *mqtt_broker = "broker.emqx.io";
const char *topic = "esp32/loc";
const char *mqtt_username = "emqx";
const char *mqtt_password = "public";
const int mqtt_port = 1883;

// =========================
// Logo
// =========================
static const uint8_t image_data_Saraarray[1024] = {
   0xff, 0xff, 0xff, 0xff, 0xff, 0xff, 0xff, 0xff, 0xff, 0xff, 0xff, 0xff, 0xff, 0xff, 0xff, 0xff, 
    0xff, 0xff, 0xf7, 0xff, 0xff, 0xff, 0xff, 0xff, 0xff, 0xff, 0xff, 0xff, 0xff, 0xff, 0xff, 0xff, 
    0xff, 0xff, 0xfb, 0xff, 0xff, 0xff, 0xff, 0xff, 0xff, 0xff, 0xff, 0xff, 0xff, 0xff, 0xff, 0xff, 
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    0xff, 0xff, 0xff, 0xff, 0xff, 0xff, 0xff, 0xff, 0xff, 0xff, 0xff, 0xff, 0xff, 0xff, 0xff, 0xff
};

WiFiClient espClient;
PubSubClient client(espClient);

unsigned long lastPublish = 0;
const unsigned long publishInterval = 3000; // 3 seconds

// =========================
// Fake GPS Path
// =========================
float startLat = 28.234662, startLng = 83.983002;
float endLat   = 28.233878, endLng   = 83.990316;

float currentLat = startLat;
float currentLng = startLng;
float stepLat = (endLat - startLat) / 20.0;   // 20 steps
float stepLng = (endLng - startLng) / 20.0;   // 20 steps

int stepCount = 0;

void showText(const String &text, int x=0, int y=0);

// =========================
// Setup
// =========================
void setup() {
  Serial.begin(115200);
  Serial.println("Initializing...");
  
  if(!display.begin(SSD1306_SWITCHCAPVCC, SCREEN_ADDRESS)) {
        Serial.println(F("SSD1306 allocation failed"));
        for(;;); // Don't proceed, loop forever
        display.display();
        delay(2000); // Pause for 2 seconds
  }

  display.clearDisplay();
  display.drawBitmap(0,0, image_data_Saraarray,128,32,1);
  display.display();
  delay(2000);

  display.clearDisplay();
  showText("Initializing.....!");


  connectToWifi();
  connectToMQTT();

  WiFi.setAutoReconnect(true);
  WiFi.persistent(true);
}

// =========================
// Main Loop
// =========================
void loop() {
  if (millis() - lastPublish >= publishInterval) {
    // Fake GPS values
    currentLat += stepLat;
    currentLng += stepLng;
    stepCount++;

    if (stepCount > 20) {  // reset path
      currentLat = startLat;
      currentLng = startLng;
      stepCount = 0;
    }

    float altitude = 850.0 + random(-10, 10);     // fake altitude (meters)
    float speed = 30.0 + random(-5, 5);           // fake speed (km/h)
    unsigned long timestamp = millis();           // fake timestamp

    // JSON-style payload
    String payload = "{";
    payload += "\"latitude\":" + String(currentLat, 6) + ",";
    payload += "\"longitude\":" + String(currentLng, 6) + ",";
    payload += "\"altitude\":" + String(altitude, 2) + ",";
    payload += "\"speed\":" + String(speed, 2) + ",";
    payload += "\"timestamp\":" + String(timestamp)+ ",";
    payload += "\"deviceId\":\"44e05f90-425a-43b5-b6f5-6225edf1b08b\"";
    payload += "}";

    String displayString = "\"lat\":" + String(currentLat, 3) + ",";
    displayString += "\"lng\":" + String(currentLng, 3) + ",";
    displayString += "\"speed\":" + String(speed, 2) + ",";
    displayString += "\"ts\":" + String(timestamp);

    if (client.connected()) {
      if (client.publish(topic, payload.c_str())) {
        Serial.println("Published: " + payload);
        display.clearDisplay();
        showText("Payload Sent!!");
        showText(displayString,0,5);
      } else {
        Serial.println("Publish failed!");
      }
    } else {
      attemptMQTTReconnect();
    }

    lastPublish = millis();
  }

  if (!client.connected()) {
    attemptMQTTReconnect();
  }
  client.loop();
}

// =========================
// WiFi Functions
// =========================
void connectToWifi() {
  Serial.print("Connecting to WiFi: ");
  Serial.println(ssid);
  WiFi.begin(ssid, password);
  showText("Connecting to wifi!",0,6);
  int retries = 0;
  while (WiFi.status() != WL_CONNECTED && retries < 20) {
    delay(500);
    Serial.print(".");
    retries++;
  }

  if (WiFi.status() == WL_CONNECTED) {
    Serial.println("\nWiFi connected. IP: " + WiFi.localIP().toString());
    showText("Connected to wifi.",0, 12);
  } else {
    Serial.println("\nFailed to connect to WiFi");
    showText("Connection Failed",0, 12);
  }
}

// =========================
// MQTT Functions
// =========================
void connectToMQTT() {
  client.setServer(mqtt_broker, mqtt_port);
  client.setCallback(callback);

  while (!client.connected()) {
    String client_id = "esp32-client-" + String(WiFi.macAddress());
    Serial.println("Connecting to MQTT...");
    showText("Connecting to MQTT...",0,17);

    if (client.connect(client_id.c_str(), mqtt_username, mqtt_password)) {
      Serial.println("MQTT connected!");
      showText("MQTT connected!",0,22);
      // client.publish(topic, "ESP32 Fake GPS connected");
    } else {
      Serial.printf("Failed, state: %d\n", client.state());
      showText("MQTT failed!",0,22);
      delay(2000);
    }
  }
}

bool attemptMQTTReconnect() {
  String client_id = "esp32-client-" + String(WiFi.macAddress());
  if (client.connect(client_id.c_str(), mqtt_username, mqtt_password)) {
    Serial.println("MQTT reconnected!");
    return true;
  }
  return false;
}

void callback(char* topic, byte* payload, unsigned int length) {
  Serial.print("Message arrived on topic: ");
  Serial.println(topic);
}

void showText(const String &text, int x, int y) {
  display.clearDisplay();
  display.setTextSize(1);                
  display.setTextColor(SSD1306_WHITE);   
  display.setCursor(x, y);                
  display.println(text);              
  display.display();                     
}
